#include "freertos/FreeRTOS.h"
#include "freertos/task.h"
#include "esp_log.h"
#include "driver/gpio.h"
#include "driver/i2c.h"
#include "driver/spi_master.h"
#include "esp_lcd_panel_io.h"
#include "esp_lcd_panel_vendor.h"
#include "esp_lcd_panel_ops.h"
#include "app_lcd.h"

#include "esp_heap_caps.h"


#include <string.h>
//#include "esp_font_ascii_8x16.h" // ESP-IDF built-in 8x16 font

#define CHAR_WIDTH   8
#define CHAR_HEIGHT  16
#define COLOR_BLACK  0x0000
#define COLOR_WHITE  0xFFFF
#define COLOR_YELLOW 0xFFE0

static const char *TAG = "APP_LCD";

// ESP32-S3-BOX-3 Pin Mapping
#define PIN_NUM_LCD_PWR     47
#define PIN_NUM_LCD_RST     48

#define PIN_NUM_LCD_PCLK    7   // SPI SCLK
#define PIN_NUM_LCD_DATA0   6   // SPI MOSI
#define PIN_NUM_LCD_CS      5   // SPI CS
#define PIN_NUM_LCD_DC      4   // SPI DC

#define PIN_NUM_I2C_SDA     8
#define PIN_NUM_I2C_SCL     18
#define I2C_NUM_PORT        0

#define TCA9554_I2C_ADDR    0x20
#define TCA9554_OUTPUT_REG  0x01
#define TCA9554_CONFIG_REG  0x03

#define LCD_HOST            SPI2_HOST
#define LCD_H_RES           320
#define LCD_V_RES           240

#define CHAR_WIDTH          8
#define CHAR_HEIGHT         16
#define COLOR_BLACK         0x0000
#define COLOR_YELLOW        0xFFE0

#define FONT_WIDTH          8
#define FONT_HEIGHT         16

#define TEXT_COLOR   0xFFFF  // White (RGB565)
#define BG_COLOR     0x0000  // Black (RGB565)

void test_print_text_dma(esp_lcd_panel_handle_t panel_handle, const char *text, int x_start, int y_start); 

// A basic 8x8 font matrix for uppercase and lowercase ASCII (Characters 'A'-'z')
// Each byte represents one row of 8 pixels (1 = text color, 0 = background color)
const uint8_t font_8x8[58][8] = {
    ['T' - 'A'] = {0xFE, 0x38, 0x38, 0x38, 0x38, 0x38, 0x38, 0x38}, // T
    ['r' - 'A'] = {0x00, 0x00, 0xAE, 0x32, 0x20, 0x20, 0x20, 0x20}, // r
    ['i' - 'A'] = {0x10, 0x00, 0x30, 0x10, 0x10, 0x10, 0x10, 0x38}, // i
    ['o' - 'A'] = {0x00, 0x00, 0x3C, 0x42, 0x42, 0x42, 0x42, 0x3C}, // o
    ['n' - 'A'] = {0x00, 0x00, 0xEC, 0x32, 0x22, 0x22, 0x22, 0x22}, // n
};




static esp_lcd_panel_handle_t panel_handle = NULL;

// Basic 8x16 ASCII font table for printable characters (0x20 to 0x7E)
static const uint8_t font_8x16[95][16] = {
    {0x00,0x00,0x00,0x00,0x00,0x00,0x00,0x00,0x00,0x00,0x00,0x00,0x00,0x00,0x00,0x00}, // ' '
    {0x00,0x00,0x18,0x3C,0x3C,0x3C,0x18,0x18,0x18,0x00,0x18,0x18,0x00,0x00,0x00,0x00}, // '!'
    {0x00,0x66,0x66,0x66,0x24,0x00,0x00,0x00,0x00,0x00,0x00,0x00,0x00,0x00,0x00,0x00}, // '"'
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    {0x00,0x00,0x3A,0x5C,0x00,0x00,0x00,0x00,0x00,0x00,0x00,0x00,0x00,0x00,0x00,0x00}  // '~'
};

static esp_err_t ensure_i2c_initialized(void)
{
    i2c_config_t i2c_conf = {
        .mode = I2C_MODE_MASTER,
        .sda_io_num = PIN_NUM_I2C_SDA,
        .scl_io_num = PIN_NUM_I2C_SCL,
        .sda_pullup_en = GPIO_PULLUP_ENABLE,
        .scl_pullup_en = GPIO_PULLUP_ENABLE,
        .master.clk_speed = 100000,
    };

    i2c_param_config(I2C_NUM_PORT, &i2c_conf);
    esp_err_t err = i2c_driver_install(I2C_NUM_PORT, I2C_MODE_MASTER, 0, 0, 0);
    if (err == ESP_ERR_INVALID_STATE) {
        return ESP_OK; // Already installed by audio BSP
    }
    return err;
}

static esp_err_t write_tca9554_reg(uint8_t reg, uint8_t val)
{
    i2c_cmd_handle_t cmd = i2c_cmd_link_create();
    i2c_master_start(cmd);
    i2c_master_write_byte(cmd, (TCA9554_I2C_ADDR << 1) | I2C_MASTER_WRITE, true);
    i2c_master_write_byte(cmd, reg, true);
    i2c_master_write_byte(cmd, val, true);
    i2c_master_stop(cmd);

    esp_err_t ret = i2c_master_cmd_begin(I2C_NUM_PORT, cmd, pdMS_TO_TICKS(1000));
    i2c_cmd_link_delete(cmd);
    return ret;
}

static esp_err_t enable_box3_hardware_power(void)
{
    ensure_i2c_initialized();

    // 1. Enable LCD Power Rail (GPIO47)
    gpio_config_t bk_gpio_config = {
        .mode = GPIO_MODE_OUTPUT,
        .pin_bit_mask = (1ULL << PIN_NUM_LCD_PWR),
    };
    gpio_config(&bk_gpio_config);
    gpio_set_level(PIN_NUM_LCD_PWR, 1);
    vTaskDelay(pdMS_TO_TICKS(100));

    // 2. Hardware Reset LCD Controller (GPIO48)
    gpio_config_t rst_gpio_config = {
        .mode = GPIO_MODE_OUTPUT,
        .pin_bit_mask = (1ULL << PIN_NUM_LCD_RST),
    };
    gpio_config(&rst_gpio_config);
    gpio_set_level(PIN_NUM_LCD_RST, 0);
    vTaskDelay(pdMS_TO_TICKS(50));
    gpio_set_level(PIN_NUM_LCD_RST, 1);
    vTaskDelay(pdMS_TO_TICKS(120));

    // 3. Enable Backlight via I2C Expander TCA9554
    write_tca9554_reg(TCA9554_CONFIG_REG, 0xFD);
    write_tca9554_reg(TCA9554_OUTPUT_REG, 0x00);

    return ESP_OK;
}

esp_err_t app_lcd_init(void)
{
    ESP_LOGI(TAG, "Initializing BOX-3 Hardware Power & Backlight...");
    ESP_ERROR_CHECK(enable_box3_hardware_power());

    ESP_LOGI(TAG, "Initializing SPI Bus...");
    spi_bus_config_t buscfg = {
        .sclk_io_num = PIN_NUM_LCD_PCLK,
        .mosi_io_num = PIN_NUM_LCD_DATA0,
        .miso_io_num = -1,
        .quadwp_io_num = -1,
        .quadhd_io_num = -1,
        .max_transfer_sz = LCD_H_RES * LCD_V_RES * sizeof(uint16_t),
    };
    ESP_ERROR_CHECK(spi_bus_initialize(LCD_HOST, &buscfg, SPI_DMA_CH_AUTO));

    ESP_LOGI(TAG, "Attaching ST7789 Panel IO...");
    esp_lcd_panel_io_handle_t io_handle = NULL;
    esp_lcd_panel_io_spi_config_t io_config = {
        .dc_gpio_num = PIN_NUM_LCD_DC,
        .cs_gpio_num = PIN_NUM_LCD_CS,
        .pclk_hz = 40 * 1000 * 1000, // 40 MHz clock frequency
        .lcd_cmd_bits = 8,
        .lcd_param_bits = 8,
        .spi_mode = 0,
        .trans_queue_depth = 10,
    };
    ESP_ERROR_CHECK(esp_lcd_new_panel_io_spi((esp_lcd_spi_bus_handle_t)LCD_HOST, &io_config, &io_handle));

    ESP_LOGI(TAG, "Installing ST7789 Panel Driver...");
    esp_lcd_panel_dev_config_t panel_config = {
        .reset_gpio_num = -1, // Reset controlled manually in enable_box3_hardware_power
        .rgb_endian = LCD_RGB_ENDIAN_BGR,
        .bits_per_pixel = 16,
    };
    ESP_ERROR_CHECK(esp_lcd_new_panel_st7789(io_handle, &panel_config, &panel_handle));

    ESP_ERROR_CHECK(esp_lcd_panel_reset(panel_handle));
    ESP_ERROR_CHECK(esp_lcd_panel_init(panel_handle));
    ESP_ERROR_CHECK(esp_lcd_panel_invert_color(panel_handle, true));
    ESP_ERROR_CHECK(esp_lcd_panel_swap_xy(panel_handle, true));
    ESP_ERROR_CHECK(esp_lcd_panel_mirror(panel_handle, false, true));
    ESP_ERROR_CHECK(esp_lcd_panel_disp_on_off(panel_handle, true));

    ESP_LOGI(TAG, "ST7789 SPI LCD Driver Initialized Successfully.");
    return ESP_OK;
}

// void app_lcd_set_status_text(const char *text)
// {
//     if (text) {
//         ESP_LOGI(TAG, "LCD Status Update: %s", text);
//     }
// }

/**
 * Draws a single ASCII character onto an RGB565 pixel buffer.
 */
// static void draw_char_to_buffer(uint16_t *buf, int buf_width, int x, int y, char c, uint16_t fg_color, uint16_t bg_color) 
// {
//     //printf("before bounds check.\n");
    
//     // 1. Bounds check
//     if (x < 0 || y < 0 || x + FONT_WIDTH > buf_width /* || y past height */) return;

//     //printf("after bounds check.\n");

//     // 2. Pixel drawing loop
//     for (int row = 0; row < FONT_HEIGHT; row++) {
//         uint8_t bits = font_8x16[(unsigned char)c][row];
//         for (int col = 0; col < FONT_WIDTH; col++) {
//             // Test most-significant or least-significant bit based on font array layout
//             uint16_t color = (bits & (0x80 >> col)) ? fg_color : bg_color;
//             buf[(y + row) * buf_width + (x + col)] = color;
//         }
//     }
// }

static void draw_char_to_buffer(uint16_t *buf, int buf_width, int buf_height, int x, int y, char c, uint16_t fg_color, uint16_t bg_color) 
{
    // 1. Bounds check (horizontal & vertical safety)
    if (x < 0 || y < 0 || (x + FONT_WIDTH) > buf_width || (y + FONT_HEIGHT) > buf_height) {
        return;
    }

    // 2. ASCII Index Mapping
    // If your font_8x16 array starts at ' ' (ASCII 32), subtract 32. 
    // If it starts at index 0 (full 256 ASCII), remove "- ' '" below.
    unsigned char char_index = (unsigned char)c;
    if (char_index < ' ' || char_index > '~') {
        char_index = ' '; // Fallback for unprintable characters
    }
    int font_idx = char_index - ' '; 

    // 3. Pre-swap colors to Big-Endian format required by ESP32 LCD controllers
    uint16_t fg_swapped = __builtin_bswap16(fg_color);
    uint16_t bg_swapped = __builtin_bswap16(bg_color);

    // 4. Pixel drawing loop
    for (int row = 0; row < FONT_HEIGHT; row++) {
        uint8_t bits = font_8x16[font_idx][row];
        for (int col = 0; col < FONT_WIDTH; col++) {
            // Check bit shift direction (0x80 >> col vs 0x01 << col depending on your font table)
            uint16_t pixel_color = (bits & (0x80 >> col)) ? fg_swapped : bg_swapped;
            
            buf[(y + row) * buf_width + (x + col)] = pixel_color;
        }
    }
}

/**
 * Renders text on the SPI LCD screen.
 */
void app_lcd_set_status_text(const char *text)
{
    return;
    
    printf("On app_lcd_set_status_text. input:%s\n",text);

    if (!text || !panel_handle) {
        return;
    }

    printf("After app_lcd_set_status_text. input:%s\n",text);

    ESP_LOGI(TAG, "LCD Status Update: %s", text);

    // Screen dimensions
    const int disp_w = LCD_H_RES; // 320
    const int disp_h = LCD_V_RES; // 240

    // Allocate frame buffer in PSRAM (or heap if PSRAM unavailable)
    size_t buf_size = disp_w * disp_h * sizeof(uint16_t);
    uint16_t *frame_buf = (uint16_t *)heap_caps_malloc(buf_size, MALLOC_CAP_SPIRAM | MALLOC_CAP_8BIT);
    if (!frame_buf) {
        frame_buf = (uint16_t *)malloc(buf_size);
    }

    if (!frame_buf) {
        ESP_LOGE(TAG, "Failed to allocate memory for frame buffer");
        return;
    }

    // Fill background with black
    for (int i = 0; i < disp_w * disp_h; i++) {
        frame_buf[i] = COLOR_BLACK;
    }

    // Render string line by line with wrapping
    int margin_x = 10;
    int margin_y = 20;
    int cur_x = margin_x;
    int cur_y = margin_y;
    int max_x = disp_w - margin_x - CHAR_WIDTH;

    int len = strlen(text);
    for (int i = 0; i < len; i++) {
        char c = text[i];

        if (c == '\n' || cur_x > max_x) {
            cur_x = margin_x;
            cur_y += CHAR_HEIGHT + 4; // Line spacing
            if (cur_y > disp_h - CHAR_HEIGHT) {
                break; // Screen full
            }
            if (c == '\n') continue;
        }

        //draw_char_to_buffer(frame_buf, disp_w,cur_x, cur_y, c, COLOR_YELLOW, COLOR_BLACK);
        draw_char_to_buffer(frame_buf, disp_w,disp_h,cur_x, cur_y, c, COLOR_YELLOW, COLOR_BLACK);

        cur_x += CHAR_WIDTH;
    }

    printf("Before esp_lcd_panel_draw_bitmap was called.\n");

    // Flush frame buffer to SPI LCD
    esp_lcd_panel_draw_bitmap(panel_handle, 0, 0, disp_w, disp_h, frame_buf);
    //test_print_text_dma(panel_handle,"Trion",0,0);

    printf("After esp_lcd_panel_draw_bitmap was called.\n");

    // Free allocated frame buffer
    free(frame_buf);
}

void test_print_text_dma(esp_lcd_panel_handle_t panel_handle, const char *text, int x_start, int y_start) 
{
    int text_len = strlen(text);
    
    // Calculate size of the combined bitmap window
    int total_width = text_len * CHAR_WIDTH;
    int total_height = CHAR_HEIGHT;
    size_t buffer_size = total_width * total_height * sizeof(uint16_t);

    // 1. Allocate DMA-capable memory for the text block
    uint16_t *text_buffer = (uint16_t *)heap_caps_malloc(buffer_size, MALLOC_CAP_DMA);
    if (text_buffer == NULL) {
        printf("DMA buffer allocation failed!\n");
        return;
    }

    // 2. Render text characters into the 1D RGB565 buffer row-by-row
    for (int y = 0; y < CHAR_HEIGHT; y++) {
        for (int c = 0; c < text_len; c++) {
            char ch = text[c];
            uint8_t font_row = 0;

            // Simple boundary protection for our test font array mapping
            if (ch >= 'A' && ch <= 'z') {
                font_row = font_8x8[ch - 'A'][y];
            }

            // Map the 8 bits of this row to RGB565 pixels
            for (int x = 0; x < CHAR_WIDTH; x++) {
                // Check if the bit is set from left to right (MSB to LSB)
                bool is_pixel_on = (font_row & (0x80 >> x)) != 0;
                
                // Calculate position in the final continuous 1D buffer
                int buffer_index = (y * total_width) + (c * CHAR_WIDTH + x);
                
                text_buffer[buffer_index] = is_pixel_on ? TEXT_COLOR : BG_COLOR;
            }
        }
    }

    // 3. Push the fake text bitmap straight to the LCD panel
    int x_end = x_start + total_width;
    int y_end = y_start + total_height;
    
    esp_lcd_panel_draw_bitmap(panel_handle, x_start, y_start, x_end, y_end, text_buffer);

    // Reminder: In production, track 'text_buffer' in your color_trans_done callback 
    // to free() it once DMA transmission finishes.
}
